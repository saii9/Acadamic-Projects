/*@!Encoding:1252*/
includes
{
  
}

variables
{
 int R1, R2, RN2;
 timer t1, t2; 
 message 0x222 msg2;
}

on timer t2{
  int val;
  val = @switch_1;
  if (!val) return;
  setSignal(sig3, 1);
  output(msg2);
}

on timer t1{
  R1 -= RN2;
  @lcd_1 = R1;  
  if(R1 <= 0){
    setTimer(t2,1.4);
  }else{
    setTimer(t1,1);  
  }
}

on message msg1{
  R1 = this.sig1;
  R2 = this.sig2;  
  if (R2 == 3) return;
  write("Message to Node 2");  
  RN2 = random(4) + 1;
  @lcd_1 = R1;    
  setTimer(t1,1);
}