VERSION ""

NS_ :

BS_:

BU_: N3 N2 N1

BO_ 2 msg3: 1 N3
 SG_ sig4 : 0|8@1- (1,0) [0|0] "" Vector__XXX

BO_ 1 msg2: 2 N2
 SG_ sig3 : 0|8@1- (1,0) [0|0] "" Vector__XXX

BO_ 0 msg1: 2 N1
 SG_ sig2 : 8|8@1- (1,0) [0|0] "" Vector__XXX
 SG_ sig1 : 0|8@1- (1,0) [0|0] "" Vector__XXX

EV_ lcd_2: 0 [0|0] "" 0 1 DUMMY_NODE_VECTOR0 Vector__XXX;

EV_ lcd_1: 0 [0|0] "" 0 2 DUMMY_NODE_VECTOR0 Vector__XXX;

EV_ switch_1: 0 [0|0] "" 0 3 DUMMY_NODE_VECTOR0 Vector__XXX;

BA_DEF_  "BusType" STRING ;
BA_DEF_DEF_  "BusType" "CAN";
